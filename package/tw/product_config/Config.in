## package/tw/product_config/Config.in
```kconfig
if PACKAGE_product_config
config PRODUCT_NTGR_ROUTER_WAX206
	bool "Netgear Router WAX206"
	default n
	depends on PACKAGE_product_config

config PRODUCT_NTGR_ROUTER_WAX202
	bool "Netgear Router WAX202"
	default n
	depends on PACKAGE_product_config

endif #PACKAGE_product_config#
```

## toolchain/glibc/Config.in
```kconfig
choice
	prompt "glibc version"
	depends on TOOLCHAINOPTS && USE_GLIBC && !EXTERNAL_TOOLCHAIN
	default GLIBC_USE_VERSION_2_29
	help
	  Select the version of glibc you wish to use.

	config GLIBC_USE_VERSION_2_29
		bool "glibc 2.29"
		select GLIBC_VERSION_2_29

endchoice
```
